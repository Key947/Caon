## config/west.yml
```yaml
manifest:
  remotes:
  # ZMK Remotes
    - name: zmkfirmware
      url-base: https://github.com/zmkfirmware
  # McTech OLED Support (Personal Fork)
    - name: Key947
      url-base: https://github.com/Key947
  projects:
  # ZMK Remotes
    - name: zmk
      remote: zmkfirmware
      revision: v0.3.0
      import: app/west.yml
  # McTech OLED Support (Personal Fork)
    - name: zmk-nice-oled
      remote: Key947
      revision: main
  self:
    path: config
```
