## boards/shields/Caon/Kconfig.defconfig
```kconfig
if SHIELD_CAON

config ZMK_KEYBOARD_NAME
    default "caon"

config SPI
    default y

endif
```

## config/west.yml
```yaml
manifest:
  remotes:
  # ZMK Remotes
    - name: zmkfirmware
      url-base: https://github.com/zmkfirmware
  # OLED Support
    - name: mctechnology17
      url-base: https://github.com/mctechnology17
  projects:
  # ZMK Remotes
    - name: zmk
      remote: zmkfirmware
      revision: v0.3
      import: app/west.yml
  # OLED Support
    - name: zmk-nice-oled
      remote: mctechnology17
      revision: main
  self:
    path: config
```
